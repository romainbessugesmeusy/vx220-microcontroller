## sdkconfig.defaults
```kconfig
# Enable FreeRTOS stats formatting functions
CONFIG_FREERTOS_USE_TRACE_FACILITY=y
CONFIG_FREERTOS_USE_STATS_FORMATTING_FUNCTIONS=y

# Increase FreeRTOS task stack size
CONFIG_FREERTOS_TIMER_TASK_STACK_DEPTH=4096

# Enable UART console
CONFIG_ESP_CONSOLE_UART_DEFAULT=y
CONFIG_ESP_CONSOLE_UART_NUM=0
CONFIG_ESP_CONSOLE_UART_BAUDRATE=115200

# Enable ESP System Event Task
CONFIG_ESP_SYSTEM_EVENT_TASK_STACK_SIZE=4096

# Enable ESP Timer
CONFIG_ESP_TIMER_IMPL_FRC2=y

# Enable logging
CONFIG_LOG_DEFAULT_LEVEL_INFO=y

# Enable UART driver
CONFIG_UART_ISR_IN_IRAM=y

# Set CPU frequency
CONFIG_ESP_DEFAULT_CPU_FREQ_MHZ=240=y

# Disable PSRAM
CONFIG_ESP32_SPIRAM_SUPPORT=n
CONFIG_SPIRAM=n

# Enable PSRAM if available
CONFIG_ESP32_SPIRAM_SUPPORT=y 
```
